## config/west.yml
```yaml
manifest:
  remotes:
    - name: zmkfirmware
      url-base: https://github.com/petejohanson
    - name: ray24777
      url-base: https://github.com/ray24777
  projects:
    - name: zmk
      remote: zmkfirmware
      revision: feat/pointers-move-scroll
      import: app/west.yml
    - name: elin-peripheral-animation
      remote: ray24777
      revision: main 
  self:
    path: config
```
